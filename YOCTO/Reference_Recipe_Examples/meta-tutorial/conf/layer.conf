## YOCTO/Reference_Recipe_Examples/meta-tutorial/conf/layer.conf
```bitbake
# We have a conf and classes directory, add to BBPATH
BBPATH .= ":${LAYERDIR}"

# We have recipes-* directories, add to BBFILES
BBFILES += "${LAYERDIR}/recipes-*/*/*.bb \
            ${LAYERDIR}/recipes-*/*/*.bbappend"

BBFILE_COLLECTIONS += "meta-tutorial"
BBFILE_PATTERN_meta-tutorial = "^${LAYERDIR}/"
BBFILE_PRIORITY_meta-tutorial = "6"


LAYERDEPENDS_meta-tutorial = "core"
LAYERSERIES_COMPAT_meta-tutorial = "dunfell"
```
